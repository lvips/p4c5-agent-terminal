## hardware/p4c5-agent-terminal/main/Kconfig.projbuild
```kconfig
menu "P4C5 Agent Terminal"

    config P4C5_BOARD_VERSION
        string "Board version string"
        default "v0.1.0"
        help
            Board version displayed at boot and reported via WebSocket.

    config P4C5_4G_ENABLED
        bool "Enable 4G modem (ML307C)"
        default y
        help
            Initialize ML307C Cat.1 modem on boot.
            If disabled, only WiFi (via ESP-Hosted C5) is available.

    config P4C5_LVGL_ENABLED
        bool "Enable LVGL UI"
        default y
        help
            Start LVGL display task with ST7102 LCD + ST7123 touch.

    config P4C5_AUDIO_DUMP_ENABLED
        bool "Enable audio dump to SD card"
        default n
        help
            Record raw PCM to SD card for debugging.
            Requires SD card mounted.

    config P4C5_AEC_ENABLED
        bool "Enable AEC (Acoustic Echo Cancellation)"
        default y
        help
            Feed I2S DAC output as AEC reference channel to ES7210.

    menu "DSH Client Configuration"

        config P4C5_DSH_WEBSOCKET_URL
            string "DSH WebSocket URL"
            default "ws://dsh.example.com/ws"
            help
                WebSocket URL for DSH (DeepSeek Harness) server.
                Example: ws://192.168.1.100:8765/ws

        config P4C5_DSH_DEVICE_ID
            string "DSH Device ID"
            default "p4c5-001"
            help
                Unique device identifier sent to DSH server.

        config P4C5_DSH_AUTH_TOKEN
            string "DSH Auth Token"
            default ""
            help
                Authentication token for DSH server.
                Leave empty if server does not require authentication.

    endmenu

endmenu
```
